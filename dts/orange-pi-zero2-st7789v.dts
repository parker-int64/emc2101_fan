/dts-v1/;
/plugin/;

#include <dt-bindings/gpio/gpio.h>

/ {
    compatible = "xunlong,orangepi-zero2", "allwinner,sun50i-h616";
    fragment@0 {
        target = <&spi1>;
        __overlay__ {
            status = "okay";
            #address-cells = <1>;
            #size-cells = <0>;

            display@1 {
                status = "okay";
                compatible = "sitronix,st7789v";
                reg = <1>;
                bgr;
                fps = <60>;
                buswidth = <8>;
                rotate = <270>;
                spi-max-frequency = <80000000>;             // 80MHz
                reset-gpios = <&pio 2 9 GPIO_ACTIVE_LOW>;   // PC9
                dc-gpios = <&pio 2 6 GPIO_ACTIVE_HIGH>;     // PC6
                led-gpios = <&pio 2 5 GPIO_ACTIVE_HIGH>;    // PC5
                spi-cpol;
                spi-cpha;
            };
        };
    };
};