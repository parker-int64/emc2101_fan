/dts-v1/;
/plugin/;

/ {
    compatible = "xunlong,orangepi-zero2", "allwinner,sun50i-h616";
    fragment@0 {
        target-path="/";
        __overlay__ {
            hardware = "EMC2101 Fan Controller";
        };
    };

    fragment@1 {
        target = <&i2c3>;
        __overlay__ {
            #address-cells = <1>;
            #size-cells = <0>;
            emc2101@4c {
                compatible = "microchip,emc2101";
                reg  = <0x4c>;
                status = "okay";
            };
        };
    };
};