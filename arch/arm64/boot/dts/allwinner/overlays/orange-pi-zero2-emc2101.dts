/dts-v1/;
/plugin/;

/ {
	compatible = "xunlong,orangepi-zero2", "allwinner,sun50i-h616";

	fragment@0 {
		target = <&i2c0>;
		__overlay__ {
			emc2101@4c {
				compatible = "microchip,emc2101";
				reg = <0x4c>;
				status = "okay";
			};
		};

	};
};
